## conf/layer.conf
```bitbake
# We have a conf and classes directory, add to BBPATH
BBPATH .= ":${LAYERDIR}"

# We have recipes-* directories, add to BBFILES
BBFILES += "${LAYERDIR}/recipes-*/*/*.bb \
	${LAYERDIR}/recipes-*/*/*.bbappend"

BBFILE_COLLECTIONS += "microblx"
BBFILE_PATTERN_microblx = "^${LAYERDIR}/"
BBFILE_PRIORITY_microblx = "3"

LAYERDEPENDS_microblx = "openembedded-layer"

LAYERSERIES_COMPAT_microblx = "rocko"
```
